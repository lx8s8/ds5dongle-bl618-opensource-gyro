## boot/manager/defconfig
```kconfig
CONFIG_CHERRYUSB =y
CONFIG_CHERRYUSB_DEVICE =y
CONFIG_CHERRYUSB_DEVICE_HID =y
CONFIG_DEBUG =n
CONFIG_COREDUMP =n
CONFIG_CONSOLE_UART_BAUDRATE =115200

CONFIG_PMP_NOT_INIT=y
```

## defconfig
```kconfig
CONFIG_FREERTOS =y
CONFIG_BLUETOOTH =y
CONFIG_RF =y
CONFIG_BTBLECONTROLLER_LIB =ble1m2s1bredr1
CONFIG_BFLB_MTD =y
CONFIG_PARTITION =y
# Use the same unencrypted 4 MiB application layout in CI and Dev Cube.
CONFIG_OVERRIDE_PTFILE =firmware/lctech616/partition_cfg_4M_nosec.toml
CONFIG_LITTLEFS =y
CONFIG_CHERRYUSB =y
CONFIG_CHERRYUSB_OSAL =freertos
CONFIG_CHERRYUSB_DEVICE =y
CONFIG_CHERRYUSB_DEVICE_HID =y
CONFIG_CHERRYUSB_DEVICE_AUDIO =y
CONFIG_EM_SIZE =32
CONFIG_CONSOLE_UART_BAUDRATE =115200
```
